## base_external/package/aesd-char-driver/Config.in
```kconfig
config BR2_PACKAGE_AESD_CHAR_DRIVER
	bool "AESD_CHAR_DRIVER"
	help
	  Includes the aesd char driver
```

## base_external/package/aesdchar/Config.in
```kconfig
config BR2_PACKAGE_AESDCHAR
	bool "AESDCHAR_DRIVER"
	help
	  Includes the aesd char driver
```
